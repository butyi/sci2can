; -----------------------------------------------------------
; Assambly font definitions. Generated from font_visual.php.
; These are already in I2C command format. Jump to [ascii*11]
; -----------------------------------------------------------
#ROM

fonttab

        ;       Command of action (Write 9 bytes to IIC)
        ;       |   Co=0 (continuous), D/C#=1 (next bytes are data)
        ;       |   |   First (most left) column of character
        ;       |   |   |   Last (most right) column of character
        ;       |   |   |   +-----------------------+   End of action
        ;       |   |   |     (LSB:Top MSB:bottom)  |   |
        db      $09,$40,$00,$00,$00,$00,$00,$00,$00,$00,$00 ; ' ' 0 = 0x00
        db      $09,$40,$00,$00,$00,$00,$00,$00,$00,$00,$00 ; ' ' 1 = 0x01
        db      $09,$40,$00,$00,$00,$00,$00,$00,$00,$00,$00 ; ' ' 2 = 0x02
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        db      $09,$40,$00,$00,$00,$00,$00,$00,$00,$00,$00 ; '' 127 = 0x7F

fonttab_len     equ     $-fonttab

